## metadata/meta-mediatek-bsp/wic/mediatek-bootimg.wks
```
# short-description: Create an image for MediaTek SoC based boards
# long-description: Creates a partitioned image for MediaTek SoC based boards with extlinux

bootloader --ptable gpt --timeout=0
part --source rawcopy --sourceparams="file=fip.bin" --part-name bootloaders --align 512 --fixed-size 4M
part /boot --source bootimg-partition --fstype=vfat --label BOOT --active --align 2048 --size 128 --sourceparams="loader=u-boot" --use-uuid
part / --source rootfs --fstype=ext4 --label rootfs --part-name rootfs --align 4 --use-uuid --exclude-path boot/ --active
```

## metadata/meta-rity/meta-rity-skeleton/conf/distro/rity-skeleton.conf
```bitbake
# WARNING: please update the rity docs if you modify this file

require conf/distro/rity.inc

DISTRO = "rity-skeleton"
DISTRO_NAME = "RITY skeleton"
```

## metadata/meta-rity/meta-rity-skeleton/conf/machine/i500-skeleton.conf
```bitbake
# WARNING: please update the rity docs if you modify this file

require conf/machine/include/mt8183.inc

# Kernel
KERNEL_DEVICETREE = "mediatek/mt8183-skeleton.dtb"

# U-Boot
UBOOT_MACHINE = "mt8183_pumpkin_defconfig"

DISTRO_FEATURES:append = " dtbo "
MACHINE_FEATURES:append = " alsa usbgadget usbhost"

MACHINEOVERRIDES =. "mt8183-skeleton:mt8385-skeleton:i500-skeleton:"
```

## metadata/meta-rity/meta/conf/machine/include/rity-i300-pumpkin.inc
```bitbake
KERNEL_DEVICETREE_OVERLAYS_AUTOLOAD += " \
	${@bb.utils.contains("MACHINE_FEATURES", "vesper-hat", "vesper.dtbo", "", d)} \
	${@bb.utils.contains("I300_PUMPKIN_AUDIO_CONF", "i2s", "audio-i2s.dtbo", "", d)} \
"
```

## metadata/meta-rity/meta/recipes-core/board-assets/files/fdt.its
```
/dts-v1/;

/ {
        description = "Flattened Device Tree blob";
        #address-cells = <1>;

        images {
                default = "fdt-mediatek_FDTBIN";
                fdt-mediatek_FDTBIN {
                        description = "Flattened Device Tree blob";
                        data = /incbin/("FDTBIN");
                        type = "flat_dt";
                        arch = "arm64";
                        compression = "none";
                        hash-1 {
                                algo = "sha256";
                        };
                        signature-1 {
                                algo = "sha256,rsa3072";
                                key-name-hint = "u-boot-img";
                        };
                };
        };

        configurations {
                default = "conf-mediatek_FDTBIN";
                conf-mediatek_FDTBIN {
                        description = "FDT blob";
                        fdt = "fdt-mediatek_FDTBIN";

                        hash-1 {
                                algo = "sha256";
                        };
                        signature-1 {
                                algo = "sha256,rsa3072";
                                key-name-hint = "u-boot";
                                padding = "pkcs-1.5";
                                sign-images = "fdt";
                        };
                };
        };
};
```

## metadata/meta-rity/meta/wic/mediatek.wks
```
# SHORT-description: Create an image for MediaTek SoC based boards
# long-description: Creates a partitioned image for MediaTek SoC based boards.

bootloader --ptable gpt --timeout=0
part --source rawcopy --sourceparams="file=fip.bin" --part-name bootloaders --align 512 --fixed-size 4M
part --source rawcopy --sourceparams="file=fitImage" --part-name kernel --size 15M
part / --source rootfs --fstype=ext4 --label rootfs --part-name rootfs --part-type B921B045-1DF0-41C3-AF44-4C6F280D3FAE --active
```
