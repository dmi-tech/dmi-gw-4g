## build/conf/bblayers.conf
```bitbake
# POKY_BBLAYERS_CONF_VERSION is increased each time build/conf/bblayers.conf
# changes incompatibly
POKY_BBLAYERS_CONF_VERSION = "2"

BBPATH = "${TOPDIR}"
BBFILES ?= ""

BBLAYERS ?= " \
  /mnt/sdb1/yocto/metadata/poky/meta \
  /mnt/sdb1/yocto/metadata/poky/meta-poky \
  /mnt/sdb1/yocto/metadata/poky/meta-yocto-bsp \
  /mnt/sdb1/yocto/metadata/meta-openembedded/meta-oe \
  /mnt/sdb1/yocto/metadata/meta-openembedded/meta-python \
  /mnt/sdb1/yocto/metadata/meta-openembedded/meta-multimedia \
  /mnt/sdb1/yocto/metadata/meta-openembedded/meta-networking \
  /mnt/sdb1/yocto/metadata/meta-arm/meta-arm \
  /mnt/sdb1/yocto/metadata/meta-arm/meta-arm-toolchain \
  /mnt/sdb1/yocto/metadata/meta-clang \
  /mnt/sdb1/yocto/metadata/meta-mediatek-bsp \
  /mnt/sdb1/yocto/metadata/meta-security \
  /mnt/sdb1/yocto/metadata/meta-rity/meta \
  /mnt/sdb1/yocto/metadata/meta-rity/meta-rity-bringup \
  /mnt/sdb1/yocto/metadata/meta-skytech-board \
  "
```

## metadata/meta-rity/meta-rity-bringup/conf/distro/rity-bringup.conf
```bitbake
require conf/distro/rity.inc

DISTRO = "rity-bringup"
DISTRO_NAME = "Rity bringup"

DISTRO_FEATURES:append = " bringup fwupdate"
DISTRO_FEATURES:remove = " pulseaudio "

PACKAGECONFIG:append:pn-weston-init = " no-idle-timeout"

# Remove 'fwupdate' for genio-1200-evk-norboot-ufs platform
# because this feature isn't yet supported.
DISTRO_FEATURES:remove:genio-1200-evk-norboot-ufs = " fwupdate "
```

## metadata/meta-rity/meta-rity-demo/conf/distro/rity-demo.conf
```bitbake
require conf/distro/rity.inc

DISTRO = "rity-demo"
DISTRO_NAME = "Rity Demo Layer"

INIT_MANAGER = "systemd"

DISTRO_FEATURES:append = " pipewire demo pam fwupdate expand-rootfs btf"
DISTRO_FEATURES_FILTER_NATIVESDK:append = " wayland"
VIRTUAL-RUNTIME_vim = "vim"

# Mount /var/log/ in persistence storage,
# so it is possible to keep journalctl logs.
VOLATILE_LOG_DIR = "0"

PACKAGECONFIG:append:pn-weston-init = " no-idle-timeout"

PACKAGE_CLASSES ?= "package_deb"
PACKAGE_FEED_URIS ?= "http://192.168.96.20:9876"
EXTRA_IMAGE_FEATURES:append = " package-management "
```

## metadata/meta-rity/meta/conf/distro/rity.inc
```bitbake
require conf/distro/poky.conf

DISTRO = "rity"
DISTRO_NAME = "Rity"
DISTRO_VERSION = "25.0-release"

# set WKS_FILE according to features
python() {
    if bb.utils.contains('MACHINE_FEATURES', 'efi', True, False, d):
        wks_file = "rity-efi.wks.in"
    elif bb.utils.contains('MACHINE_FEATURES', 'nor-boot', True, False, d):
        wks_file = "rity-nofw.wks.in"
    else:
        wks_file = "rity.wks.in"

    # Set the WKS_FILE variable in the BitBake environment
    d.setVar('WKS_FILE', wks_file)
}
IMAGE_HOME_SIZE = "200M"

# Boot configuration tweaks
KERNEL_CLASSES = "kernel-fitimage-mtk kernel-mod-image"
UBOOT_ENV_SUFFIX = "script"
UBOOT_ENV = "boot"
include conf/machine/include/rity-${MACHINE}.inc
```

## metadata/meta-skytech-board/conf/distro/distro-skytech-genio-350.conf
```bitbake
require conf/distro/rity.conf
# ===================== Distro: custom (Genio 350) =====================
# Image/WIC
WKS_FILE = "mediatek-bootimg.wks"
WIC_CREATE_EXTRA_ARGS = "--no-fstab-update"

# ===== Base features & init =====
DISTRO_FEATURES:append = " security usrmerge systemd pam"
# Runtime ptest suites are not needed on the deploy image and trigger a
# pseudo/tar failure in Perl on this host.
DISTRO_FEATURES:remove = " ptest"
VIRTUAL-RUNTIME_init_manager = "systemd"
VIRTUAL-RUNTIME_udev = "udev"
PREFERRED_PROVIDER_virtual/udev = "systemd"
DISTRO_FEATURES_BACKFILL_CONSIDERED += "sysvinit"
VIRTUAL-RUNTIME_initscripts = "systemd-compat-units"

# ===== Image features =====
IMAGE_FEATURES += " ssh-server-openssh"
EXTRA_IMAGE_FEATURES += " debug-tweaks"

IMAGE_INSTALL:append = " \
    udev \
    dhcpcd \
    opencl-headers opencl-icd-loader clinfo \
    gstreamer1.0 gstreamer1.0-plugins-base gstreamer1.0-plugins-good \
    gstreamer1.0-plugins-bad gstreamer1.0-plugins-ugly \
    i2c-tools can-utils usbutils \
    nano python3 python3-pip \
    networkmanager avahi-daemon networkmanager-wifi \
    iproute2 iputils net-tools procps gdb \
    alsa-state \
	alsa-utils \
    pipewire \
	pipewire-spa-tools \
	pipewire-tools \
	pipewire-alsa \
	pipewire-pulse \
	pipewire-v4l2 \
	pipewire-modules-rt \
	pipewire-modules-protocol-native \
	pipewire-modules-client-node \
	pipewire-modules-client-device \
	pipewire-modules-adapter \
	pipewire-modules-metadata \
	pipewire-modules-session-manager \
	pipewire-modules-profiler \
	pipewire-modules-spa-device-factory \
	pipewire-modules-portal \
	pipewire-modules-access \
	pipewire-modules-link-factory \
	pipewire-spa-plugins-dbus \
	pipewire-spa-plugins-bluez5 \
	pipewire-spa-plugins-codec-bluez5-aac \
	pipewire-spa-plugins-codec-bluez5-lc3 \
	pipewire-spa-plugins-v4l2 \
	pipewire-spa-plugins-alsa \
	wireplumber \
	wireplumber-modules-lua-scripting \
	wireplumber-modules-default-nodes-api \
	wireplumber-modules-meta \
	wireplumber-modules-file-monitor-api \
	wireplumber-modules-si-audio-adapter \
	wireplumber-modules-si-standard-link \
	wireplumber-modules-si-node \
	wireplumber-modules-mixer-api \
	wireplumber-modules-logind \
"
```

## metadata/meta-skytech-board/conf/machine/skytech-genio-350.conf
```bitbake
require conf/machine/genio-350-evk.conf

# Custom memory configuration for 2GB RAM board
# OP-TEE gets 64MB, Linux gets the rest
OPTEE_DRAM_SIZE = "0x4000000"

# Use overlay device tree
KERNEL_DEVICETREE = "mediatek/mt8365-evk.dtb"
KERNEL_DEVICETREE_OVERLAYS_AUTOLOAD += "gpu-mali.dtbo"
# Board identification
LIBDRAM_BOARD_NAME = "mt8365-sb35"
LK_BOARD_NAME = "${LIBDRAM_BOARD_NAME}"

# FORCE override WKS file
WKS_FILE:forcevariable = "genio-350-16gb.wks"

# Dependencies
WKS_FILE_DEPENDS = "dosfstools-native mtools-native parted-native e2fsprogs-native wic-tools"

# wic.img + tar.xz
IMAGE_FSTYPES += "wic.img"

# Enhanced features cho development
IMAGE_FEATURES += "package-management debug-tweaks ssh-server-openssh"
SERIAL_CONSOLE = "921600;ttyS0"
APPEND += " console=ttyS0,921600n1"
```
